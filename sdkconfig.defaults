## sdkconfig.defaults
```kconfig
# sdkconfig.defaults — ESP-IDF Kconfig overrides for Elite Clock
#
# PlatformIO merges this file into the build configuration automatically.
# These values extend the watchdog timeouts so that TFT_eSPI's pushBlock()
# can complete a full fillScreen() (153,600 pixels on 480x320) without
# triggering TG1WDT_SYS_RST (interrupt watchdog) or task watchdog resets.
#
# TG1WDT_SYS_RST (rst:0x8) = Timer Group 1 = INTERRUPT watchdog.
# It fires when interrupts are disabled for > CONFIG_ESP_INT_WDT_TIMEOUT_MS.
# TFT_eSPI's SPI pushBlock loop on ESP32-C3 disables interrupts during the
# entire SPI burst transfer. At 40MHz SPI, 480x320x2 bytes takes ~60ms —
# well over the 300ms default, especially with slower actual bus speeds.

# Interrupt watchdog — raise from 300ms to 2000ms
CONFIG_ESP_INT_WDT_TIMEOUT_MS=2000

# Task watchdog — raise from 5s to 30s (belt and braces)
CONFIG_ESP_TASK_WDT_TIMEOUT_S=30

# Disable task watchdog panic (makes it log instead of reset if triggered)
CONFIG_ESP_TASK_WDT_PANIC=n
```
